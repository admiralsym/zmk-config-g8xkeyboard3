/ {
    chosen {
        zmk,kscan = &default_kscan;
    };

    default_kscan: kscan {
        compatible = "zmk,kscan-gpio-matrix";
        label = "default_kscan";
        diode-direction = "col2row";

        row-gpios = 
                    <&gpio0 9 (GPIO_ACTIVE_HIGH | GPIO_PULL_DOWN)>;

        col-gpios = 
                    <&gpio1 13 GPIO_ACTIVE_HIGH>;

    };

};